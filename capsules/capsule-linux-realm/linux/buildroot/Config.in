## capsules/capsule-linux-realm/linux/buildroot/Config.in
```kconfig
menu "AOS Realm development tools"

source "$BR2_EXTERNAL_AOS_PATH/package/aos-ninja/Config.in"

endmenu
```

## capsules/capsule-linux-realm/linux/buildroot/configs/aos_rv64_defconfig
```kconfig
BR2_riscv=y
BR2_riscv_custom=y
BR2_RISCV_ISA_RVM=y
BR2_RISCV_ISA_RVA=y
BR2_RISCV_64=y
BR2_RISCV_ABI_LP64=y
BR2_KERNEL_HEADERS_6_18=y
BR2_TOOLCHAIN_BUILDROOT_MUSL=y
BR2_STATIC_LIBS=y
BR2_REPRODUCIBLE=y
BR2_DOWNLOAD_FORCE_CHECK_HASHES=y
BR2_PRIMARY_SITE="https://sources.buildroot.net"
BR2_INIT_NONE=y
BR2_ROOTFS_DEVICE_CREATION_STATIC=y
BR2_ROOTFS_STATIC_DEVICE_TABLE="$(BR2_EXTERNAL_AOS_PATH)/board/aos/device-table.txt"
# BR2_TARGET_ENABLE_ROOT_LOGIN is not set
BR2_TARGET_GENERIC_HOSTNAME="aos-realm"
BR2_TARGET_GENERIC_ISSUE=""
BR2_SYSTEM_BIN_SH_BUSYBOX=y
BR2_ROOTFS_USERS_TABLES="$(BR2_EXTERNAL_AOS_PATH)/board/aos/users.txt"
BR2_ROOTFS_POST_BUILD_SCRIPT="$(BR2_EXTERNAL_AOS_PATH)/board/aos/post-build.sh"
BR2_ROOTFS_POST_FAKEROOT_SCRIPT="$(BR2_EXTERNAL_AOS_PATH)/board/aos/post-fakeroot.sh"
BR2_TARGET_ROOTFS_CPIO=y
# BR2_TARGET_ROOTFS_TAR is not set
```

## capsules/capsule-linux-realm/linux/buildroot/package/aos-ninja/Config.in
```kconfig
config BR2_PACKAGE_AOS_NINJA
	bool "ninja"
	depends on BR2_INSTALL_LIBSTDCPP
	depends on BR2_USE_MMU
	help
	  Ninja is a small build system with a focus on speed. Buildroot's
	  built-in Ninja package is host-only; AOS Realm deliberately builds
	  the same pinned source for the target development environment.

	  https://ninja-build.org/
```
